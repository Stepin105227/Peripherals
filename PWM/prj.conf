## prj.conf
```kconfig
# nothing here
#C++ support configs
CONFIG_CPLUSPLUS=y
CONFIG_NEWLIB_LIBC=y
CONFIG_LIB_CPLUSPLUS=y
CONFIG_HEAP_MEM_POOL_SIZE=16348

CONFIG_STDOUT_CONSOLE=y
CONFIG_LOG=y

#GPIO
CONFIG_GPIO=y
CONFIG_OPENOCD_SUPPORT=n

CONFIG_PWM=y
```

## boards/bl653_dvk.overlay
```dts
&pwm0 {
    status = "okay";
    ch0-pin = <30>;
};

	
```

## src/main.c
```c
#include <zephyr.h>
#include <device.h>
#include <devicetree.h>
#include <drivers/pwm.h>
#include "main.h"

#define PWM_CH0_PIN DT_PROP(DT_NODELABEL(pwm0), ch0_pin)
// port
const char *pwm0port = "PWM_0";

// device structure
const struct device *m_dev_pwm0;

// static valiable
static uint16_t duty_cycle_percent=75;
static uint8_t flag =0;
static uint32_t desired_frequency = 250000;
static uint32_t period_cycle =0;
static uint32_t pulse_cycle =0;

void main(void)
{
	
	k_sleep(K_SECONDS(1));
	printk("\n PWM Demo Start....\n");
	enable_pwm();
	if(duty_cycle_percent!=0)
	{
		duty_cycle_percent = (duty_cycle_percent * 65535)/100;
		// printk("\n Duty cycle is %ld",duty_cycle_percent);
	}

	configuration_set(NORMAL_POLARITY,desired_frequency, duty_cycle_percent);
	// printk("\ndesired_frequency : %d duty_cycle_percent : %d ",desired_frequency,duty_cycle_percent);
	generate_pwm();
	
}
/*******************************************************************
See header file for function definition
********************************************************************/
void generate_pwm()
{
	uint8_t ret;
	ret = pwm_pin_set_cycles(m_dev_pwm0,PWM_CH0_PIN,period_cycle,pulse_cycle,flag);
	if(ret ==0)
	{
		// printk("\n pwm_pin_set_cycles is working");
	}
	else
	{
		printk("\n pwm_pin_set_cycles is not working ");
	}
}


/*******************************************************************
See header file for function definition
********************************************************************/

void configuration_set(uint8_t polarity, uint32_t frequency, uint16_t duty_cycle)
{
	uint8_t ret;
	uint64_t cycle_per_second;
	flag = polarity;
	ret = pwm_get_cycles_per_sec(m_dev_pwm0, PWM_CH0_PIN, &cycle_per_second);
	if(ret ==0)
	{
		// printk("\n cycle_per_second %lld",cycle_per_second);
		// printk("\n desired_frequency %ld",desired_frequency);
		period_cycle = cycle_per_second/desired_frequency;
		// printk("\n Period_cycle %ld",period_cycle);
		// printk("\n pwm_get_cycles_per_sec is working properly ");
	}
	else
	{
		printk("\n pwm_get_cycles_per_sec is not working properly ");
	}

	pulse_cycle = (duty_cycle * period_cycle)>>16;
    // printk("\n Pulse_cycle is %ld",pulse_cycle);
}


/*******************************************************************
See header file for function definition
********************************************************************/

void enable_pwm(void)
{
	m_dev_pwm0 = device_get_binding(pwm0port);
	if (m_dev_pwm0 == NULL)
	{
		printk("Device Binding for PWM_0 failed\n");
	}
	else
	{
		printk("Device Binding for PWM_0 success\n");
	}
}
```

## include/main.h
```c
#include <stdio.h>
#include <string.h>
enum
{
	NORMAL_POLARITY = PWM_POLARITY_NORMAL,
	INVERTED_POLARITY = PWM_POLARITY_INVERTED
};

/*
* @brief 
  Set the device binding for pwm0
*/
void enable_pwm(void);

/*
* @brief Set all the configuration for PWM 
  @param d_polarity set the polarity (PWM_POLARITY_NORMAL or PWM_POLARITY_INVERTED) as per requirment
  @param d_frequency set the frequency in KHz
  @param d_duty_cycle set the duty cycle from 0% to 100%
*/
void configuration_set(uint8_t d_polarity, uint32_t d_frequency, uint16_t d_duty_cycle);

/*
 * @brief Set the period and pulse width for a single PWM output.
 * it will generate the PWM pulse 
 */
void generate_pwm(void);
```
